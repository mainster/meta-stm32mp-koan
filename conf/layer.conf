## conf/layer.conf
```bitbake
# We have a conf and classes directory, add to BBPATH
BBPATH .= ":${LAYERDIR}"

# We have recipes-* directories, add to BBFILES
BBFILES += "${LAYERDIR}/recipes-*/*/*.bb \
            ${LAYERDIR}/recipes-*/*/*.bbappend"

BBFILE_COLLECTIONS += "stm32mp-koan"
BBFILE_PATTERN_stm32mp-koan = "^${LAYERDIR}/"
BBFILE_PRIORITY_stm32mp-koan = "7"
LAYERVERSION_stm32mp-koan = "4"
LAYERSERIES_COMPAT_stm32mp-koan = "thud"

# Avoid parse of these .bbappend contained in meta-st-openlinux,
#  because meta-openembedded have 1.14.4 version for gstreamer
#  packages and 1.16.0 version for v4l-utils.
#  A copy of patches applied by these .bbappends are in this layer
BBMASK += "gstreamer1.0-libav_1.14.2.bbappend"
BBMASK += "gstreamer1.0-plugins-bad_1.14.2.bbappend"
BBMASK += "gstreamer1.0-plugins-base_1.14.2.bbappend"
BBMASK += "gstreamer1.0-plugins-good_1.14.2.bbappend"
BBMASK += "v4l-utils_1.12.3.bbappend"
```
